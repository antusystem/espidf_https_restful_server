## main/Kconfig.projbuild
```kconfig
menu "Example Configuration"

    config EXAMPLE_MDNS_HOST_NAME
        string "mDNS Host Name"
        default "esp-home"
        help
            Specify the domain name used in the mDNS service.
            Note that webpage also take it as a part of URL where it will send GET/POST requests to.

    config EXAMPLE_WEB_MOUNT_POINT
        string "Website mount point in VFS"
        default "/www"
        help
            Specify the mount point in VFS.

    config EXAMPLE_WIFI_SSID
        string "WiFi SSID"
        default "myssid"
        help
            SSID (network name) for the example to connect to.

    config EXAMPLE_WIFI_PASSWORD
        string "WiFi Password"
        default "mypassword"
        help
            WiFi password (WPA or WPA2) for the example to use.

    config ESP_MAXIMUM_RETRY
        int "Maximum retry"
        default 5
        help
            Set the Maximum retry to avoid station reconnecting to the AP unlimited when the AP is really inexistent.

    choice ESP_WIFI_SCAN_AUTH_MODE_THRESHOLD
        prompt "WiFi Scan auth mode threshold"
        default ESP_WIFI_AUTH_OPEN
        help
            The weakest authmode to accept in the scan mode.
        config EXAMPLE_WIFI_AUTH_OPEN
            bool "OPEN"
        config EXAMPLE_WIFI_AUTH_WEP
            bool "WEP"
        config EXAMPLE_WIFI_AUTH_WPA_PSK
            bool "WPA PSK"
        config EXAMPLE_WIFI_AUTH_WPA2_PSK
            bool "WPA2 PSK"
        config EXAMPLE_WIFI_AUTH_WPA_WPA2_PSK
            bool "WPA/WPA2 PSK"
        config EXAMPLE_WIFI_AUTH_WPA3_PSK
            bool "WPA3 PSK"
        config EXAMPLE_WIFI_AUTH_WPA2_WPA3_PSK
            bool "WPA2/WPA3 PSK"
        config EXAMPLE_WIFI_AUTH_WAPI_PSK
            bool "WAPI PSK"
    endchoice

endmenu
```
